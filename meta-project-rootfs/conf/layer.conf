## meta-project-rootfs/conf/layer.conf
```bitbake
# We have a conf and classes directory, add to BBPATH
BBPATH .= ":${LAYERDIR}"

# We have recipes-* directories, add to BBFILES
BBFILES += "${LAYERDIR}/recipes-*/*/*.bb \
            ${LAYERDIR}/recipes-*/*/*.bbappend"

BBFILE_COLLECTIONS += "meta-project-rootfs"
BBFILE_PATTERN_meta-project-rootfs = "^${LAYERDIR}/"
BBFILE_PRIORITY_meta-project-rootfs = "10"

LAYERDEPENDS_meta-project-rootfs = "core"
LAYERSERIES_COMPAT_meta-project-rootfs = "hardknott"
```
